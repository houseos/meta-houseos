## conf/distro/debian-buster-house-os.conf
```bitbake
# meta-odyssey
# debian-buster-house-os.conf
# SPDX-License-Identifier: MIT
# Copyright (C) 2020 Benjamin Schilling

require conf/distro/cip-core-buster.conf 

DISTRO_APT_SOURCES = "conf/distro/debian-buster-house-os.list"

# Relevant apt keys
DOCKER_KEY = "https://download.docker.com/linux/debian/gpg;sha256sum=1500c1f56fa9e26b9b8f42452a553675796ade0807cdce11975eb98170b3a570"
DART_KEY = "https://dl-ssl.google.com/linux/linux_signing_key.pub;sha256sum=5dfdccb6f67eea65aeb717f1ef90a81fa80fe77c60f4d3dfdf45c969748069c5"
DEBIAN_KEY = "https://ftp-master.debian.org/keys/archive-key-10.asc;sha256sum=9c854992fc6c423efe8622c3c326a66e73268995ecbe8f685129063206a18043"

# Target Distro
DISTRO_BOOTSTRAP_KEYS ?= "${DOCKER_KEY} ${DART_KEY} ${DEBIAN_KEY}"
DISTRO_APT_PREFERENCES = "conf/distro/preferences.docker.conf"

# Distro for building
HOST_DISTRO = "debian-buster-house-os"
HOST_DISTRO_KEYS ?= "${DART_KEY} ${DEBIAN_KEY}"
HOST_DISTRO_APT_SOURCES ?= "conf/distro/debian-buster-house-os.list"
```

## conf/layer.conf
```bitbake
# meta-odyssey
# layer.conf
# SPDX-License-Identifier: MIT
# Copyright (C) 2020 Benjamin Schilling

BBPATH .= ":${LAYERDIR}"

BBFILES += "${LAYERDIR}/recipes-*/*/*.bb \
             ${LAYERDIR}/recipes-*/*/*.bbappend"

BBFILE_COLLECTIONS += "meta-houseos"
BBFILE_PATTERN_meta-houseos = "^${LAYERDIR}/recipes-"
BBFILE_PRIORITY_meta-houseos = "200"

LAYERSERIES_COMPAT_meta-houseos = "next master"

LAYERDIR_meta-houseos = "${LAYERDIR}"
```

## conf/machine/live.conf
```bitbake
# meta-odyssey
# live.conf
# SPDX-License-Identifier: MIT
# Copyright (C) 2020 Benjamin Schilling

IMAGE_FSTYPE ?= "wic-img"

DISTRO_ARCH ?= "amd64"

KERNEL_NAME ?= "amd64"

BOOTLOADER ?= "grub"

WKS_FILE ?= "live"

IMAGER_INSTALL += "${GRUB_BOOTLOADER_INSTALL}"
```

## conf/machine/seeed-odyssey.conf
```bitbake
# meta-odyssey
# seeed-odyssey.conf
# SPDX-License-Identifier: MIT
# Copyright (C) 2020 Benjamin Schilling

IMAGE_TYPE ?= "wic-img"

DISTRO_ARCH ?= "amd64"

KERNEL_NAME ?= "amd64"

BOOTLOADER ?= "grub"

WKS_FILE ?= "odyssey"

IMAGER_INSTALL += "${GRUB_BOOTLOADER_INSTALL}"
```

## wic/live.wks
```
# meta-odyssey
# live.wks
# SPDX-License-Identifier: MIT
# Copyright (C) 2020 Benjamin Schilling

part /boot --source bootimg-efi-isar --sourceparams "loader=grub-efi" --ondisk sda --label efi --part-type EF00 --align 1024

part / --source rootfs  --ondisk sda --fstype ext4 --label rootfs --align 1024 

bootloader --ptable gpt --timeout 5
```

## wic/odyssey.wks
```
# meta-odyssey
# odyssey.wks
# SPDX-License-Identifier: MIT
# Copyright (C) 2020 Benjamin Schilling

part /boot --source bootimg-efi-isar --sourceparams "loader=grub-efi" --ondisk mmcblk0 --label efi --part-type EF00 --align 1024

part / --source rootfs  --ondisk sda --fstype ext4 --label rootfs --align 1024 --use-uuid --extra-space 1000M

bootloader --ptable gpt --timeout 5
```
